## firmware/bridge/components/printer_link/Kconfig
```kconfig
menu "Printer link (Marlin UART)"

    config PRINTER_LINK_UART_NUM
        int "UART port number"
        range 1 2
        default 1

    config PRINTER_LINK_TX_GPIO
        int "ESP TX GPIO (to printer RX, DEBUG pin 4)"
        default 17

    config PRINTER_LINK_RX_GPIO
        int "ESP RX GPIO (from printer TX, DEBUG pin 3)"
        default 18

    config PRINTER_LINK_BAUD
        int "Baud rate"
        default 250000

    config PRINTER_LINK_OK_TIMEOUT_MS
        int "Wait for 'ok' timeout (ms)"
        default 15000
        help
            How long one command may go without an "ok". A "busy:" line from Marlin restarts
            the wait. After the timeout the link is marked NO_REPLY and the next command is sent.

    config PRINTER_LINK_QUEUE_LEN
        int "Command queue length"
        default 16

endmenu
```

## firmware/bridge/components/printer_state/Kconfig
```kconfig
menu "Laser (road_Change.md ch. 8)"

    config LASER_ENABLE_GPIO
        int "Laser enable GPIO, -1 = none"
        range -1 48
        default -1
        help
            An ESP32-S3 output that only the bridge switches: on while the laser is armed,
            off at once on disarm, STOP, lease timeout, kill or a lost printer link, without
            waiting for Marlin's queue. Wire it to a driver input or a MOSFET in the laser's
            supply, in series with the Marlin fan output, with a pull-down (or pull-up for
            active low) so the laser stays off while the ESP boots or is unplugged.
            -1: no pin, the laser is switched by the fan output only.
            Refused at start (arming then refused, error in the log): 17 / 18 (printer UART),
            19 / 20 (USB console), 26..37 (flash, octal PSRAM), 0 / 3 / 45 / 46 (strapping:
            the pull-down would change the boot mode). Until printer_state starts (about the
            first second after a reset) only the external pull resistor holds it off.

    config LASER_ENABLE_ACTIVE_LOW
        bool "Enable pin is active low"
        default n
        depends on LASER_ENABLE_GPIO >= 0

endmenu
```

## firmware/shared/components/wifi_link/Kconfig
```kconfig
menu "WiFi link"

    config WIFI_LINK_HOSTNAME
        string "Hostname (mDNS name without .local)"
        default "m200"

    config WIFI_LINK_DEFAULT_SSID
        string "Default SSID (used only if NVS has none)"
        default ""
        help
            Only for the first boot. It ends up in sdkconfig, which git ignores.
            Better: set it at runtime from the USB console with  !wifi <ssid> <password>
            The credentials are then stored in NVS and survive firmware updates.

    config WIFI_LINK_DEFAULT_PASSWORD
        string "Default password"
        default ""

endmenu
```
